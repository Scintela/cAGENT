## Kconfig
```kconfig
menu "cAgent Core"

choice AGENT_PROFILE
    prompt "Core capacity profile"
    default AGENT_PROFILE_DEFAULT

config AGENT_PROFILE_TINY
    bool "Tiny"

config AGENT_PROFILE_DEFAULT
    bool "Default"

config AGENT_PROFILE_DEVICE_REACT
    bool "Device ReAct"

config AGENT_PROFILE_CUSTOM
    bool "Custom"

endchoice

config AGENT_MAX_TOOLS
    int "Maximum registered tools" if AGENT_PROFILE_CUSTOM
    range 0 64
    default 4 if AGENT_PROFILE_TINY
    default 16 if AGENT_PROFILE_DEVICE_REACT
    default 12

config AGENT_MAX_CONTEXTS
    int "Maximum dynamic and Memory context contributions" if AGENT_PROFILE_CUSTOM
    range 0 32
    default 2 if AGENT_PROFILE_TINY
    default 8

config AGENT_MAX_SKILLS
    int "Maximum registered skills" if AGENT_PROFILE_CUSTOM
    range 0 32
    default 2 if AGENT_PROFILE_TINY
    default 12 if AGENT_PROFILE_DEVICE_REACT
    default 8

config AGENT_MAX_SESSIONS
    int "RAM session slots (transitional)" if AGENT_PROFILE_CUSTOM
    range 1 32
    default 1 if AGENT_PROFILE_TINY
    default 4

config AGENT_SESSION_EVENT_CAPACITY
    int "RAM session event capacity (transitional)" if AGENT_PROFILE_CUSTOM
    range 1 1024
    default 24 if AGENT_PROFILE_TINY
    default 96

config AGENT_SESSION_PAYLOAD_BYTES
    int "RAM session payload bytes (transitional)" if AGENT_PROFILE_CUSTOM
    range 256 1048576
    default 2048 if AGENT_PROFILE_TINY
    default 8192

config AGENT_MAX_PROJECTED_MESSAGES
    int "Maximum projected messages per model request" if AGENT_PROFILE_CUSTOM
    range 1 256
    default 8 if AGENT_PROFILE_TINY
    default 48 if AGENT_PROFILE_DEVICE_REACT
    default 32

config AGENT_SCRATCH_BYTES
    int "Core turn scratch bytes" if AGENT_PROFILE_CUSTOM
    range 1024 1048576
    default 8192 if AGENT_PROFILE_TINY
    default 24576 if AGENT_PROFILE_DEVICE_REACT
    default 12288

config AGENT_MAX_INPUT_BYTES
    int "Maximum input bytes" if AGENT_PROFILE_CUSTOM
    range 1 1048576
    default 512 if AGENT_PROFILE_TINY
    default 2048 if AGENT_PROFILE_DEVICE_REACT
    default 1024

config AGENT_MAX_CONTEXT_BYTES
    int "Maximum context bytes" if AGENT_PROFILE_CUSTOM
    range 1 1048576
    default 2048 if AGENT_PROFILE_TINY
    default 8192 if AGENT_PROFILE_DEVICE_REACT
    default 4096

config AGENT_MAX_SCHEMA_BYTES
    int "Maximum tool schema bytes" if AGENT_PROFILE_CUSTOM
    range 1 1048576
    default 1024 if AGENT_PROFILE_TINY
    default 4096 if AGENT_PROFILE_DEVICE_REACT
    default 2048

config AGENT_MAX_ARGUMENTS_BYTES
    int "Maximum tool arguments bytes" if AGENT_PROFILE_CUSTOM
    range 1 1048576
    default 512 if AGENT_PROFILE_TINY
    default 2048 if AGENT_PROFILE_DEVICE_REACT
    default 1024

config AGENT_MAX_TOOL_OUTPUT_BYTES
    int "Maximum tool output bytes" if AGENT_PROFILE_CUSTOM
    range 1 1048576
    default 512 if AGENT_PROFILE_TINY
    default 2048 if AGENT_PROFILE_DEVICE_REACT
    default 1024

config AGENT_MAX_MODEL_OUTPUT_BYTES
    int "Maximum model output bytes" if AGENT_PROFILE_CUSTOM
    range 1 1048576
    default 1024 if AGENT_PROFILE_TINY
    default 4096 if AGENT_PROFILE_DEVICE_REACT
    default 2048

config AGENT_MAX_MODEL_TOOL_CALLS
    int "Maximum tool calls in one model response" if AGENT_PROFILE_CUSTOM
    range 0 64
    default 2 if AGENT_PROFILE_TINY
    default 8 if AGENT_PROFILE_DEVICE_REACT
    default 4

config AGENT_MAX_NAME_BYTES
    int "Maximum tool/skill name bytes" if AGENT_PROFILE_CUSTOM
    range 1 1024
    default 32 if AGENT_PROFILE_TINY
    default 64

config AGENT_MAX_DESCRIPTION_BYTES
    int "Maximum tool/skill description bytes" if AGENT_PROFILE_CUSTOM
    range 1 8192
    default 128 if AGENT_PROFILE_TINY
    default 512 if AGENT_PROFILE_DEVICE_REACT
    default 256

config AGENT_MAX_IDENTIFIER_BYTES
    int "Maximum identifier bytes" if AGENT_PROFILE_CUSTOM
    range 1 1024
    default 32 if AGENT_PROFILE_TINY
    default 64

config AGENT_MAX_JSON_DEPTH
    int "Maximum JSON nesting depth" if AGENT_PROFILE_CUSTOM
    range 1 128
    default 8 if AGENT_PROFILE_TINY
    default 24 if AGENT_PROFILE_DEVICE_REACT
    default 16

config AGENT_CORE_WORKSPACE_BYTES
    int "Core caller workspace bytes" if AGENT_PROFILE_CUSTOM
    range 4096 1048576
    default 16384 if AGENT_PROFILE_TINY
    default 49152 if AGENT_PROFILE_DEVICE_REACT
    default 32768

config AGENT_MODEL_WORKSPACE_BYTES
    int "Model wrapper workspace bytes" if AGENT_PROFILE_CUSTOM
    range 128 65536
    default 128

config AGENT_DEFAULT_MAX_STEPS
    int "Default maximum steps" if AGENT_PROFILE_CUSTOM
    range 1 1000
    default 4 if AGENT_PROFILE_TINY
    default 12 if AGENT_PROFILE_DEVICE_REACT
    default 8

config AGENT_DEFAULT_TIMEOUT_MS
    int "Default overall timeout (ms)" if AGENT_PROFILE_CUSTOM
    range 0 3600000
    default 15000 if AGENT_PROFILE_TINY
    default 60000 if AGENT_PROFILE_DEVICE_REACT
    default 30000

config AGENT_DEFAULT_MODEL_TIMEOUT_MS
    int "Default model timeout (ms)" if AGENT_PROFILE_CUSTOM
    range 0 3600000
    default 10000 if AGENT_PROFILE_TINY
    default 45000 if AGENT_PROFILE_DEVICE_REACT
    default 15000

config AGENT_DEFAULT_TOOL_TIMEOUT_MS
    int "Default tool timeout (ms)" if AGENT_PROFILE_CUSTOM
    range 0 3600000
    default 2000 if AGENT_PROFILE_TINY
    default 5000 if AGENT_PROFILE_DEVICE_REACT
    default 3000

config AGENT_DEFAULT_MAX_TOOL_CALLS
    int "Default maximum tool calls per turn" if AGENT_PROFILE_CUSTOM
    range 0 1024
    default 2 if AGENT_PROFILE_TINY
    default 8 if AGENT_PROFILE_DEVICE_REACT
    default 4

config AGENT_DEFAULT_MAX_OUTPUT_TOKENS
    int "Default model output token limit" if AGENT_PROFILE_CUSTOM
    range 0 65536
    default 256 if AGENT_PROFILE_TINY
    default 1024 if AGENT_PROFILE_DEVICE_REACT
    default 512

config AGENT_DEFAULT_MAX_HISTORY_TURNS
    int "Default projected history turns" if AGENT_PROFILE_CUSTOM
    range 0 1024
    default 0

endmenu

menu "cAgent Optional File Storage"

config AGENT_FILE_STORE
    bool "Byte-file contracts and bounded read helpers"
    default n

config AGENT_POSIX_FILE_STORE
    bool "POSIX byte-file backend"
    depends on AGENT_FILE_STORE
    default n
    help
      Access one application-mounted trusted directory. The application owns
      all buffers and serializes operations. No JSON or Session dependency.

endmenu

menu "cAgent Session Storage"

config AGENT_SESSION_RAM
    bool "Volatile caller-storage Session provider"
    default n

config AGENT_SESSION_JSONL
    bool "JSONL Session provider with application-supplied file operations"
    default n

endmenu

menu "cAgent Model Providers"

config AGENT_PROVIDER_OPENAI
    bool "OpenAI-compatible Chat Completions provider"
    default n

endmenu

menu "cAgent Memory Providers"

config AGENT_MEMORY_MARKDOWN
    bool "Bounded Markdown Memory over application-authorized file stores"
    depends on AGENT_FILE_STORE
    default n
    help
      Read explicit Soul/User/Memory documents and dated notes. Ordinary writes
      cannot modify Soul. No automatic extraction, directory scan or heap cache.

endmenu
```

## ports/espidf/Kconfig
```kconfig
menu "cAgent ESP-IDF Port"

config AGENT_PORT_ESPIDF_RUNTIME
    bool "Build ESP-IDF Runtime adapter"
    default y
    help
      Add the esp_timer based clock builder. This option does not start tasks
      or initialize networking.

config AGENT_PORT_ESPIDF_TRANSPORT
    bool "Build ESP-IDF HTTP Transport adapter"
    default n
    help
      Add the esp_http_client based synchronous HTTP transport.

config AGENT_PORT_ESPIDF_FILE_STORE
    bool "Build ESP-IDF shared byte-file store"
    depends on AGENT_FILE_STORE && AGENT_POSIX_FILE_STORE
    depends on VFS_SUPPORT_IO && VFS_SUPPORT_DIR
    default n
    help
      Bind a trusted application-mounted VFS directory to byte-file ops.
      Supports bounded text loading and optional JSONL binding. No mount or
      format operations are performed. Validate filesystem calls on target.

config AGENT_PORT_ESPIDF_STORAGE
    bool "Build ESP-IDF JSONL Session file binding"
    depends on AGENT_SESSION_JSONL && AGENT_SESSION_POSIX_FILES
    default n
    help
      Bind JSONL file operations to an application-mounted ESP-IDF VFS
      directory. The library does not mount or format the filesystem.

endmenu
```

## ports/openvela/Kconfig
```kconfig
menu "cAgent OpenVela Port"

config AGENT_PORT_OPENVELA_RUNTIME
    bool "Build OpenVela monotonic-clock Runtime"
    default n
    help
      Add the allocation-free CLOCK_MONOTONIC Runtime builder. Applications
      may separately provide logging and cross-task cancel synchronization.

config AGENT_PORT_OPENVELA_TRANSPORT
    bool "Build OpenVela webclient HTTP Transport"
    depends on NETUTILS_WEBCLIENT
    default n
    help
      Add the synchronous NuttX webclient HTTP adapter. HTTPS additionally
      needs an application-supplied authenticated webclient TLS implementation.

config AGENT_PORT_OPENVELA_FILE_STORE
    bool "Build OpenVela shared byte-file store"
    depends on AGENT_FILE_STORE
    depends on !DISABLE_MOUNTPOINT
    default n
    help
      Bind one trusted mounted directory to byte-file operations. This
      independently selectable package has no JSONL or JSON dependency.
      Validate filesystem support and durability on the target device.

config AGENT_PORT_OPENVELA_STORAGE
    bool "Build OpenVela JSONL Session file binding"
    depends on AGENT_SESSION_JSONL
    default n
    help
      Bind JSONL file operations to an application-mounted NuttX filesystem.
      This option also compiles the shared POSIX file implementation.

endmenu
```

## ports/rtthread/Kconfig
```kconfig
# SPDX-License-Identifier: MIT
# SPDX-FileCopyrightText: 2026 tanglinjie
# Source the root cAgent Kconfig separately before this file.
menu "cAgent RT-Thread ports"
config AGENT_PORT_RTTHREAD_RUNTIME
    bool "RT-Thread 5.1+ clock and cancellation Runtime"
    default n
    help
      Caller-owned static timer samples the 32-bit tick. No automatic init.
      Requires RT-Thread 5.1+ spinlock API, also on uniprocessor builds.

config AGENT_PORT_RTTHREAD_TRANSPORT
    bool "WebClient synchronous POST Transport"
    depends on PKG_USING_WEBCLIENT && RT_USING_HEAP && !WEBCLIENT_DEBUG
    default n
    help
      WebClient 2.3 API, nonempty POST only, redirects rejected.
      HTTPS requires a verified TLS backend configured by the application.
      Cancellation/deadlines cannot interrupt blocking SDK network calls.

config AGENT_PORT_RTTHREAD_FILE_STORE
    bool "DFS/POSIX byte-file store"
    depends on RT_USING_DFS && RT_USING_POSIX_FS
    select AGENT_FILE_STORE
    select AGENT_POSIX_FILE_STORE
    default n

config AGENT_PORT_RTTHREAD_NO_SYMLINKS
    bool "Trusted mounted filesystem has no symbolic links"
    depends on AGENT_POSIX_FILE_STORE
    default n
    help
      Explicitly permit stat instead of lstat on trusted VFS mounts without
      symbolic-link support. Do not enable on filesystems supporting symlinks.
endmenu
```
